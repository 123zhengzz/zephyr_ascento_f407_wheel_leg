## boards/arm/dji_f407igh6_c/Kconfig.board
```kconfig
config BOARD_DJI_F407IGH6_C
	bool "DJI RoboMaster Development Board Type C"
	depends on SOC_STM32F407XG
```

## boards/arm/dji_f407igh6_c/board.yml
```yaml
board:
  name: dji_f407igh6_c
  full_name: DJI RoboMaster Development Board Type C
  vendor: dji
  socs:
    - name: stm32f407xx
```

## boards/arm/dji_f407igh6_c/dji_f407igh6_c_defconfig
```kconfig
CONFIG_FLASH_SIZE=1024
CONFIG_SRAM_SIZE=192

CONFIG_CLOCK_CONTROL=y
CONFIG_GPIO=y
CONFIG_PINCTRL=y
CONFIG_SERIAL=y
CONFIG_UART_CONSOLE=y
CONFIG_CONSOLE=y

CONFIG_ARM_MPU=y
CONFIG_HW_STACK_PROTECTION=y
CONFIG_FPU=y
```
